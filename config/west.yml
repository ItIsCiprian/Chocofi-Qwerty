## config/west.yml
```yaml
manifest:
  remotes:
    - name: zmkfirmware
      url-base: https://github.com/zmkfirmware
    - name: customrepo
      url-base: https://github.com/your-username

  projects:
    - name: zmk
      remote: zmkfirmware
      revision: main
      import: app/west.yml
    - name: custom_shields
      remote: customrepo
      revision: main
      path: shields/custom_shields

  self:
    path: config
```
